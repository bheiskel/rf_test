## CMakeLists.txt
```
#
# Copyright (c) 2018 Nordic Semiconductor
#
# SPDX-License-Identifier: LicenseRef-Nordic-5-Clause
#
cmake_minimum_required(VERSION 3.20.0)

find_package(Zephyr REQUIRED HINTS $ENV{ZEPHYR_BASE})
project(NONE)

zephyr_include_directories(src)
FILE(GLOB app_sources src/*.c)
target_sources(app PRIVATE ${app_sources})
set(SB_CONF_FILE sysbuild.conf)
set(CMAKE_EXPORT_COMPILE_COMMANDS ON)
```

## Kconfig
```
#
# Copyright (c) 2020 Nordic Semiconductor
#
# SPDX-License-Identifier: LicenseRef-Nordic-5-Clause
#

source "Kconfig.zephyr"

menu "Enhanced ShockBurst: Receiver"

config ESB_PRX_APP_LOG_LEVEL
	int "Log level for the ESB PRX sample"
	default 4


config RADIO_TEST_RX_TIMEOUT
	int "RX packet reception timeout"
	default 10
	help
	  Specifies the time in seconds that the application waits for the first packet to be
	  received in RX mode when a specified number of packets are set to be received.
	  If the timeout is reached before the first packet is received, the radio will be disabled.
endmenu
```

## prj.conf
```kconfig
#
# Copyright (c) 2019 Nordic Semiconductor ASA
#
# SPDX-License-Identifier: LicenseRef-Nordic-5-Clause
#
CONFIG_NCS_SAMPLES_DEFAULTS=y
CONFIG_ESB=y
CONFIG_NRFX_TIMER0=y
CONFIG_NRFX_GPPI=y
CONFIG_CLOCK_CONTROL_NRF_K32SRC_RC=y
CONFIG_CLOCK_CONTROL_NRF_K32SRC_XTAL=n
CONFIG_DYNAMIC_INTERRUPTS=y
CONFIG_SERIAL=n
CONFIG_LOG=n
CONFIG_GPIO_NRFX=y
CONFIG_ENTROPY_GENERATOR=y
```

## boards/nrf54l15dk_nrf54l15_cpuapp.conf
```kconfig
#
# Copyright (c) 2023 Nordic Semiconductor
#
# SPDX-License-Identifier: LicenseRef-Nordic-5-Clause
#

# Disable the unsupported driver
CONFIG_NRFX_TIMER0=n

# Enable the necessary drivers
CONFIG_NRFX_TIMER10=y
CONFIG_NRFX_GPPI=y
CONFIG_NRFX_DPPI10=y
CONFIG_NRFX_GRTC=y
```

## boards/nrf52833dk_nrf52820.overlay
```dts
&uicr {
	nfct-pins-as-gpios;
};

&reg1 {
	regulator-initial-mode = <NRF5X_REG_MODE_LDO>;
};
```

## boards/nrf52833dk_nrf52833.overlay
```dts
&uicr {
	nfct-pins-as-gpios;
};


&reg1 {
	regulator-initial-mode = <NRF5X_REG_MODE_LDO>;
};

&reg0 {
	status="disabled";
};
```

## boards/nrf52840dk_nrf52811.overlay
```dts
&uicr {
	nfct-pins-as-gpios;
};

&reg {
	regulator-initial-mode = <NRF5X_REG_MODE_LDO>;
};
```

## boards/nrf52840dk_nrf52840.overlay
```dts
&uicr {
	nfct-pins-as-gpios;
};


&reg1 {
	regulator-initial-mode = <NRF5X_REG_MODE_LDO>;
};
&reg0 {
	status = "disabled";
};
```

## boards/nrf52dk_nrf52832.overlay
```dts
&uicr {
	nfct-pins-as-gpios;
};

&reg {
	regulator-initial-mode = <NRF5X_REG_MODE_LDO>;
};
```

## boards/nrf54l15dk_nrf54l10_cpuapp.overlay
```dts
&uicr {
	nfct-pins-as-gpios;
};

&vregmain {
	status = "okay";
	regulator-initial-mode = <NRF5X_REG_MODE_DCDC>;
};

&dppic10{
	status="okay";
};
```

## src/main.c
```c
#include <zephyr/devicetree.h>
#if defined(CONFIG_CLOCK_CONTROL_NRF)
#include <zephyr/drivers/clock_control.h>
#include <zephyr/drivers/clock_control/nrf_clock_control.h>
#endif /* #if defined(CONFIG_CLOCK_CONTROL_NRF) */
#include <hal/nrf_gpio.h>
#include <zephyr/irq.h>
#include <zephyr/logging/log.h>
#include <nrf.h>
#include <esb.h>
#include <zephyr/kernel.h>
#include <zephyr/types.h>
#include "radio_test.h"

#if defined(CONFIG_SOC_NRF54L15) || defined(CONFIG_SOC_NRF54L10) || defined(CONFIG_SOC_NRF54L05)
#include <hal/nrf_oscillators.h>
#include <hal/nrf_clock.h>
#endif

LOG_MODULE_REGISTER(esb_prx, CONFIG_ESB_PRX_APP_LOG_LEVEL);
enum {
	RADIO_TEST_MODE_TX_MOD_CARRIER,
	RADIO_TEST_MODE_TX_UNMOD_CARRIER,
	RADIO_TEST_MODE_RX_MODE,
	RADIO_TEST_MODE_TX_UNMOD_SWEEP,
	RADIO_TEST_MODE_RX_MODE_SWEEP,
	RADIO_TEST_MODE_RANGE_TEST, /* Not implemented */
};



typedef struct __attribute__((packed)) {
	uint8_t first_rf_channel;
	uint8_t last_rf_channel;
	uint8_t radio_power;
	uint8_t datarate;
	uint8_t fem_config;
	uint8_t rf_cmd;

} rf_test_t;
static struct esb_payload rx_payload;
static volatile bool payload_received;

void event_handler(struct esb_evt const *event)
{
	switch (event->evt_id) {
	case ESB_EVENT_TX_SUCCESS:
		LOG_DBG("TX SUCCESS EVENT");
		break;
	case ESB_EVENT_TX_FAILED:
		LOG_DBG("TX FAILED EVENT");
		break;
	case ESB_EVENT_RX_RECEIVED:
		if (esb_read_rx_payload(&rx_payload) == 0) {
			payload_received = true;
		} else {
			LOG_ERR("Error while reading rx packet");
		}
		break;
	}
}

#if defined(CONFIG_CLOCK_CONTROL_NRF)
int clocks_start(void)
{
	int err;
	int res;
	struct onoff_manager *clk_mgr;
	struct onoff_client clk_cli;

	clk_mgr = z_nrf_clock_control_get_onoff(CLOCK_CONTROL_NRF_SUBSYS_HF);
	if (!clk_mgr) {
		LOG_ERR("Unable to get the Clock manager");
		return -ENXIO;
	}

	sys_notify_init_spinwait(&clk_cli.notify);

	err = onoff_request(clk_mgr, &clk_cli);
	if (err < 0) {
		LOG_ERR("Clock request failed: %d", err);
		return err;
	}

	do {
		err = sys_notify_fetch_result(&clk_cli.notify, &res);
		if (!err && res) {
			LOG_ERR("Clock could not be started: %d", res);
			return res;
		}
	} while (err);
#if defined(NRF54L15_XXAA)
	/* MLTPAN-20 */
	nrf_clock_task_trigger(NRF_CLOCK, NRF_CLOCK_TASK_PLLSTART);
#endif /* defined(NRF54L15_XXAA) */


	LOG_DBG("HF clock started");
	return 0;
}
#endif /* #if defined(CONFIG_CLOCK_CONTROL_NRF) */



	
int esb_initialize(void)
{
	int err;
	/* These are arbitrary default addresses. In end user products
	 * different addresses should be used for each set of devices.
	 */
	uint8_t base_addr_0[4] = { 0x33, 0x44, 0xBB, 0x01 };
	uint8_t base_addr_1[4] = { 0xDE, 0xF0, 0x12, 0x23 };
	uint8_t addr_prefix[8] = { 0x22, 0xBC, 0x66, 0xC4, 0xC5, 0xC6, 0xC7, 0xC8 };

	struct esb_config config = ESB_DEFAULT_CONFIG;

	config.protocol = ESB_PROTOCOL_ESB_DPL;
	config.bitrate = ESB_BITRATE_2MBPS;
	config.mode = ESB_MODE_PRX;
	config.event_handler = event_handler;
	config.selective_auto_ack = true;
	if (IS_ENABLED(CONFIG_ESB_FAST_SWITCHING)) {
		config.use_fast_ramp_up = true;
	}

	err = esb_init(&config);
	if (err) {
		return err;
	}

	err = esb_set_base_address_0(base_addr_0);
	if (err) {
		return err;
	}

	err = esb_set_base_address_1(base_addr_1);
	if (err) {
		return err;
	}

	err = esb_set_prefixes(addr_prefix, ARRAY_SIZE(addr_prefix));
	if (err) {
		return err;
	}

	return 0;
}




int main(void)
{
	int err;
	bool fem = false;
	bool transmitting = false;


	uint8_t pin_pdn = 0xFF;
	uint8_t pin_txen = 0xFF;
	uint8_t pin_rxen = 0xFF;
	uint8_t pin_mode = 0xFF;
	uint8_t pin_antsel = 0xFF;
#if defined(CONFIG_SOC_NRF54L15) || defined(CONFIG_SOC_NRF54L10) || defined(CONFIG_SOC_NRF54L05)
	uint32_t load_cap = (volatile uint32_t) NRF_UICR->OTP[0];
	uint32_t fem_config_0 = (volatile uint32_t) NRF_UICR->OTP[1];
	uint32_t fem_config_1 = (volatile uint32_t) NRF_UICR->OTP[2];

	switch(load_cap){
		case 0xFFFFFFFF:
			break;
		case 0:
			nrf_oscillators_hfxo_cap_set(NRF_OSCILLATORS, 0, 0);
			break;
		default:
			nrf_oscillators_hfxo_cap_set(NRF_OSCILLATORS, 1, OSCILLATORS_HFXO_CAP_CALCULATE(NRF_FICR, load_cap/4));}
#else
	uint32_t fem_config_0 = (volatile uint32_t) NRF_UICR->CUSTOMER[1];
	uint32_t fem_config_1 = (volatile uint32_t) NRF_UICR->CUSTOMER[2];
#endif

	if(fem_config_0 != 0xFFFFFFFF || fem_config_1 != 0xFFFFFFFF){
		fem	= true;
		pin_pdn = fem_config_0 & 0xFF;
		pin_txen = (fem_config_0 >> 8) & 0xFF;
		pin_rxen = (fem_config_0 >> 16) & 0xFF;
		pin_mode = (fem_config_0 >> 24) & 0xFF;
		pin_antsel = fem_config_1 & 0xFF;

		if(pin_pdn != 0xFF){
			nrf_gpio_cfg_output(pin_pdn);
			nrf_gpio_pin_write(pin_pdn, 1);
		}
		if(pin_txen != 0xFF){
			nrf_gpio_cfg_output(pin_txen);
			nrf_gpio_pin_write(pin_txen, 0);
		}
		if(pin_rxen != 0xFF){
			nrf_gpio_cfg_output(pin_rxen);
			nrf_gpio_pin_write(pin_rxen, 1);
		}
		if(pin_mode != 0xFF){
			nrf_gpio_cfg_output(pin_mode);
			nrf_gpio_pin_write(pin_mode, 0);
		}
		if(pin_antsel != 0xFF){
			nrf_gpio_cfg_output(pin_antsel);
			nrf_gpio_pin_write(pin_antsel, 0);
		}	
	}

	

#if defined(CONFIG_CLOCK_CONTROL_NRF)
	err = clocks_start();
	if (err) {
		return err;
	}
#endif /* #if defined(CONFIG_CLOCK_CONTROL_NRF) */


	err = esb_initialize();
	if (err) {
		LOG_ERR("ESB initialization failed, err %d", err);
		return err;
	}

	LOG_INF("Initialization complete");
	uint32_t rf_channel = 40;
	esb_set_rf_channel(rf_channel);
	LOG_INF("Setting up for packet receiption on channel %d", rf_channel);

	err = esb_start_rx();
	if (err) {
		LOG_ERR("RX setup failed, err %d", err);
		return err;
	}
	while (1) {
		if (payload_received == true) {
			payload_received = false;
			rf_test_t *rf_test_commands = (rf_test_t *)rx_payload.data;

			LOG_DBG("first_rf_channel: %d", rf_test_commands->first_rf_channel);
			LOG_DBG("last_rf_channel: %d", rf_test_commands->last_rf_channel);
			LOG_DBG("radio_power: %d", rf_test_commands->radio_power);
			LOG_DBG("datarate %d", rf_test_commands->datarate);
			LOG_DBG("fem_config: %d", rf_test_commands->fem_config);
			LOG_DBG("rf_cmd: %d", rf_test_commands->rf_cmd);

			esb_disable();

			static struct radio_test_config my_config;
			memset(&my_config, 0, sizeof(struct radio_test_config));

			switch (rf_test_commands->rf_cmd) {
			case RADIO_TEST_MODE_TX_MOD_CARRIER:
				LOG_INF("RADIO_TEST_MODE_TX_MOD_CARRIER");
				my_config.type = MODULATED_TX;
				my_config.mode = rf_test_commands->datarate;
				my_config.params.modulated_tx.pattern = TRANSMIT_PATTERN_11001100;
				my_config.params.modulated_tx.txpower =
					rf_test_commands->radio_power;
				my_config.params.modulated_tx.channel =
					rf_test_commands->first_rf_channel;
				transmitting = true;
				break;
			case RADIO_TEST_MODE_TX_UNMOD_CARRIER:
				LOG_INF("RADIO_TEST_MODE_TX_UNMOD_CARRIER");
				my_config.type = UNMODULATED_TX;
				my_config.mode = rf_test_commands->datarate;
				my_config.params.unmodulated_tx.txpower =
					rf_test_commands->radio_power;
				my_config.params.unmodulated_tx.channel =
					rf_test_commands->first_rf_channel;
				transmitting = true;
				break;
			case RADIO_TEST_MODE_RX_MODE:
				LOG_INF("RADIO_TEST_MODE_RX_MODE");
				my_config.type = RX;
				my_config.mode = rf_test_commands->datarate;
				my_config.params.rx.channel = rf_test_commands->first_rf_channel;
				break;
			case RADIO_TEST_MODE_TX_UNMOD_SWEEP:
				LOG_INF("RADIO_TEST_MODE_TX_UNMOD_SWEEP");
				my_config.type = TX_SWEEP;
				my_config.mode = rf_test_commands->datarate;
				my_config.params.tx_sweep.txpower = rf_test_commands->radio_power;
				my_config.params.tx_sweep.channel_start =
					rf_test_commands->first_rf_channel;
				my_config.params.tx_sweep.channel_end =
					rf_test_commands->last_rf_channel;
				my_config.params.tx_sweep.delay_ms = 10;
				transmitting = true;
				break;
			case RADIO_TEST_MODE_RX_MODE_SWEEP:
				LOG_INF("RADIO_TEST_MODE_RX_MODE_SWEEP");
				my_config.type = RX_SWEEP;
				my_config.mode = rf_test_commands->datarate;
				my_config.params.rx_sweep.channel_start =
					rf_test_commands->first_rf_channel;
				my_config.params.rx_sweep.channel_end =
					rf_test_commands->last_rf_channel;
				my_config.params.rx_sweep.delay_ms = 10;
				break;
			case RADIO_TEST_MODE_RANGE_TEST:
				LOG_INF("RADIO_TEST_MODE_RANGE_TEST"); /* Not implemented */
				break;
			default:
				LOG_INF("Default case - unsupported command %d",
				       rf_test_commands->rf_cmd);
				break;
			}

			if(fem){
				LOG_INF("FEM config: %d", rf_test_commands->fem_config);
				nrf_gpio_pin_write(pin_mode, rf_test_commands->fem_config & 0x01);
				nrf_gpio_pin_write(pin_antsel, (rf_test_commands->fem_config & 0x02)>>1);
				if(transmitting){
					if(pin_txen != 0xFF){
						nrf_gpio_pin_write(pin_txen, 1);
					}
					if(pin_rxen != 0xFF){
						nrf_gpio_pin_write(pin_rxen, 0);
					}
				}
			}

		
			radio_test_init(&my_config);
			/* Start radio test - needs a physical reset to stop or retest */
			radio_test_start(&my_config);
			return 0;
		}
		k_msleep(100);
	}
	/* return to idle thread */
	return 0;
}
```

## src/radio_test.h
```c
/*
 * Copyright (c) 2020 Nordic Semiconductor ASA
 *
 * SPDX-License-Identifier: LicenseRef-Nordic-5-Clause
 */

#ifndef RADIO_TEST_H_
#define RADIO_TEST_H_

#include <zephyr/types.h>
#include <hal/nrf_radio.h>

#ifdef NRF53_SERIES
#ifndef RADIO_TXPOWER_TXPOWER_Pos3dBm
	#define RADIO_TXPOWER_TXPOWER_Pos3dBm (0x03UL)
#endif /* RADIO_TXPOWER_TXPOWER_Pos3dBm */

#ifndef RADIO_TXPOWER_TXPOWER_Pos2dBm
	#define RADIO_TXPOWER_TXPOWER_Pos2dBm (0x02UL)
#endif /* RADIO_TXPOWER_TXPOWER_Pos2dBm */

#ifndef RADIO_TXPOWER_TXPOWER_Pos1dBm
	#define RADIO_TXPOWER_TXPOWER_Pos1dBm (0x01UL)
#endif /* RADIO_TXPOWER_TXPOWER_Pos1dBm */
#endif /* NRF53_SERIES */

/** Maximum radio RX or TX payload. */
#define RADIO_MAX_PAYLOAD_LEN	256
/** IEEE 802.15.4 maximum payload length. */
#define IEEE_MAX_PAYLOAD_LEN	127
/** IEEE 802.15.4 minimum channel. */
#define IEEE_MIN_CHANNEL	11
/** IEEE 802.15.4 maximum channel. */
#define IEEE_MAX_CHANNEL	26


/**@brief Radio transmit and address pattern. */
enum transmit_pattern {
	/** Random pattern. */
	TRANSMIT_PATTERN_RANDOM,

	/** Pattern 11110000(F0). */
	TRANSMIT_PATTERN_11110000,

	/** Pattern 11001100(CC). */
	TRANSMIT_PATTERN_11001100,
};

/**@brief Radio test mode. */
enum radio_test_mode {
	/** TX carrier. */
	UNMODULATED_TX,

	/** Modulated TX carrier. */
	MODULATED_TX,

	/** RX carrier. */
	RX,

	/** TX carrier sweep. */
	TX_SWEEP,

	/** RX carrier sweep. */
	RX_SWEEP,

	/** Duty-cycled modulated TX carrier. */
	MODULATED_TX_DUTY_CYCLE,
};

/**@brief Radio test configuration. */
struct radio_test_config {
	/** Radio test type. */
	enum radio_test_mode type;

	/** Radio mode. Data rate and modulation. */
	nrf_radio_mode_t mode;

	union {
		struct {
			/** Radio output power. */
			int8_t txpower;

			/** Radio channel. */
			uint8_t channel;
		} unmodulated_tx;

		struct {
			/** Radio output power. */
			int8_t txpower;

			/** Radio transmission pattern. */
			enum transmit_pattern pattern;

			/** Radio channel. */
			uint8_t channel;

			/**
			 * Number of packets to transmit.
			 * Set to zero for continuous TX.
			 */
			uint32_t packets_num;

			/** Callback to indicate that TX is finished. */
			void (*cb)(void);
		} modulated_tx;

		struct {
			/** Radio transmission pattern. */
			enum transmit_pattern pattern;

			/** Radio channel. */
			uint8_t channel;

			/**
			 * Number of packets to be received.
			 * Set to zero for continuous RX.
			 */
			uint32_t packets_num;

			/** Callback to indicate that RX is finished. */
			void (*cb)(void);
		} rx;

		struct {
			/** Radio output power. */
			int8_t txpower;

			/** Radio start channel (frequency). */
			uint8_t channel_start;

			/** Radio end channel (frequency). */
			uint8_t channel_end;

			/** Delay time in milliseconds. */
			uint32_t delay_ms;
		} tx_sweep;

		struct {
			/** Radio start channel (frequency). */
			uint8_t channel_start;

			/** Radio end channel (frequency). */
			uint8_t channel_end;

			/** Delay time in milliseconds. */
			uint32_t delay_ms;
		} rx_sweep;

		struct {
			/** Radio output power. */
			int8_t txpower;

			/** Radio transmission pattern. */
			enum transmit_pattern pattern;

			/** Radio channel. */
			uint8_t channel;

			/** Duty cycle. */
			uint32_t duty_cycle;
		} modulated_tx_duty_cycle;
	} params;

};

/**@brief Radio RX statistics. */
struct radio_rx_stats {
	/** Content of the last packet. */
	struct {
		/** Content of the last packet. */
		uint8_t *buf;

		/** Length of the last packet. */
		size_t len;
	} last_packet;

	/** Number of received packets with valid CRC. */
	uint32_t packet_cnt;
};

/**
 * @brief Function for initializing the Radio Test module.
 *
 * @param[in] config  Radio test configuration.
 *
 * @retval 0 If the operation was successful.
 *           Otherwise, a (negative) error code is returned.
 */
int radio_test_init(struct radio_test_config *config);

/**
 * @brief Function for starting radio test.
 *
 * @param[in] config  Radio test configuration.
 */
void radio_test_start(const struct radio_test_config *config);

/**
 * @brief Function for stopping ongoing test (Radio and Timer operations).
 */
void radio_test_cancel(void);

/**
 * @brief Function for get RX statistics.
 *
 * @param[out] rx_stats RX statistics.
 */
void radio_rx_stats_get(struct radio_rx_stats *rx_stats);

/**
 * @brief Function for toggling the DC/DC converter state.
 *
 * @param[in] dcdc_state  DC/DC converter state.
 */
void toggle_dcdc_state(uint8_t dcdc_state);

#endif /* RADIO_TEST_H_ */
```
